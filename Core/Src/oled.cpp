#include "oled.h"
#include "utils.h"

constexpr std::array<uint8_t, 6> font6x8[] = {
    {0x00, 0x00, 0x00, 0x00, 0x00, 0x00}, // sp
    {0x00, 0x00, 0x00, 0x2f, 0x00, 0x00}, // !
    {0x00, 0x00, 0x07, 0x00, 0x07, 0x00}, // "
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    {0x00, 0x44, 0x64, 0x54, 0x4C, 0x44}, // z
};

const std::array<uint8_t, 6> &get_font6x8(char c) { return font6x8[c - ' ']; }

void oled_driver::contrast(uint8_t contrast) {
    i2c_transmit({0x00, 0x81, contrast});
}

void oled_driver::clear(uint8_t begin_page, uint8_t end_page) {
    std::array<uint8_t, 129> data;
    data[0] = 0x40;
    std::fill(data.begin() + 1, data.end(), 0);

    page_addressing_mode();
    for (uint8_t i = begin_page; i < end_page; i++) {
        set_pos(0, i);
        i2c_transmit(data, 10);
    }
}

void oled_driver::test_seq() {
    i2c_transmit(std::array<uint8_t, 6>({0,
        0x20, 0x00, // horizontal addressing mode
        0x22, 0, 7,    // set page start/end
    }));

    std::array<uint8_t, 2> data;
    data[0] = 0x40;
    for (int m = 0; m < 2; m++) {
        if (m == 0)
            data[1] = 0xff;
        else
            data[1] = 0x00;

        for (int i = 0; i < 8; i++) {
            for (int j = 1; j < 129; j++) {
                i2c_transmit(data);
                HAL_Delay(2);
            }
        }
    }
}

void oled_driver::init(uint8_t contrast) {
    HAL_GPIO_WritePin(_pin_def.rst_port, _pin_def.rst_pin, GPIO_PIN_RESET);
    HAL_Delay(1);
    HAL_GPIO_WritePin(_pin_def.pwr_port, _pin_def.pwr_pin, GPIO_PIN_SET);
    HAL_Delay(100);
    HAL_GPIO_WritePin(_pin_def.rst_port, _pin_def.rst_pin, GPIO_PIN_SET);
    delay_us(5);

    clear();

    i2c_transmit({
        0x00, 0xA1, 0xC8, // rotate display 180 degrees
        0x81, contrast,   // set contrast
        0x8D, 0x14,       // enable charge pump
        0xAF,             // display on
    });
}

void oled_driver::page_addressing_mode() { i2c_transmit(std::array<uint8_t, 3>{0x00, 0x20, 0b10}); }

void oled_driver::set_pos(uint8_t x, uint8_t y) {
    i2c_transmit(std::array<uint8_t, 4>{0x00,
        static_cast<uint8_t>(0xb0 + y),
        static_cast<uint8_t>(x & 0xf),
        static_cast<uint8_t>(0x10 | (x >> 4))
    });
}

void oled_driver::vertical_addressing_mode() {
    i2c_transmit(std::to_array<uint8_t>({0x00, 0x20, 0b01}));
}
void oled_driver::horizontal_addressing_mode() {
    i2c_transmit(std::to_array<uint8_t>({0x00, 0x20, 0b00}));
}


void oled_driver::addressing_range(uint8_t begin_page, uint8_t end_page, uint8_t begin_col, uint8_t end_col) {
    i2c_transmit(std::to_array<uint8_t>({0x00,
        0x21, begin_col, end_col,
        0x22, begin_page, end_page,
    }));
}

oled_text_mode::oled_text_mode(oled_driver &oled) : x(0), y(0), oled(oled) {
    oled.page_addressing_mode();
    oled.set_pos(0, 0);
}

void oled_text_mode::write_string(std::string_view str_view) {
    for (char c : str_view) {
        if (c == '\n') {
            this->x = 0;
            this->y++;
            if (this->y > 7)
                this->y = 0;
            oled.set_pos(this->x, this->y);
        } else if (c == '\r') {
            this->x = 0;
            oled.set_pos(this->x, this->y);
        } else if (c == '\t') {
            this->x = this->x + 4 * 6 - this->x % (4 * 6);
            if (this->x > 120) {
                this->x = 0;
                this->y++;
                if (this->y > 7)
                    this->y = 0;
            }
            oled.set_pos(this->x, this->y);
        } else {
            std::array<uint8_t, 7> data;
            data[0] = 0x40;
            if (c >= ' ' && c <= 'z') {
                auto &font = get_font6x8(c);
                for (int i = 0; i < 6; i++)
                    data[i + 1] = font[i];
            } else {
                auto &font = get_font6x8('?');
                for (int i = 0; i < 6; i++)
                    data[i + 1] = ~font[i];
            }
            oled.i2c_transmit(data);
            this->x += 6;
            if (this->x > 120) {
                this->x = 0;
                this->y++;
                if (this->y > 7) {
                    this->y = 0;
                }
                oled.set_pos(this->x, this->y);
            }
        }
    }
}
